## drivers/input/fingerprint/fpc/Kconfig
```kconfig
config FINGERPRINT_FPC1020
	tristate "fpc fpc1020 fingerprint drvier support"
	help
	  Say Y here to enable fpc fingerprint driver support!
```

## drivers/power/supply/battery_secret/Kconfig
```kconfig
config BATT_VERIFY_BY_DS28E16
	tristate "Support ds28e16 as encryption IC"
	depends on ARCH_QCOM
	help
	  Enable support for the DS28E16 battery verification IC.
	  This driver must include the onewire physical controller required
	  for communication.
```

## drivers/power/supply/cp_manager/Kconfig
```kconfig
# SPDX-License-Identifier: GPL-2.0-only

menu "Charge Pump and PD Policy Manager"
	depends on NOPMI_CHARGER
	depends on I2C && REGMAP_I2C

config CHARGER_SC8551
	tristate "SC8551 Charger Pumper Driver"
	depends on I2C

config CHARGER_PD_POLICY
	tristate "Charger PD Policy control"
	depends on CHARGER_SC8551 || TCPC_CLASS

endmenu
```

## drivers/power/supply/maxim/Kconfig
```kconfig
menu "Maxim Charger and Fuel Gauge"
	depends on NOPMI_CHARGER

config CHARGER_MAX77729
	tristate "Support maxim charger Driver"

config FUELGAUGE_MAX77729
	tristate "Support as maxim fuel gauge IC"

endmenu
```

## drivers/power/supply/nopmi/Kconfig
```kconfig
config NOPMI_CHARGER
	tristate "NOPMI Charger Core Support"
	depends on ARCH_QCOM && I2C
	help
	  Say Y here to enable Core framework
	  for NOPMI charger modules support.

	  This driver can also be built as a module. If so,
	  the module will be called nopmi_chg_core.
```

## drivers/power/supply/syv/Kconfig
```kconfig
# SPDX-License-Identifier: GPL-2.0-only

menu "SYV (BQ2589X & SM5602) Support"
	depends on NOPMI_CHARGER
	depends on I2C && REGMAP_I2C

config CHARGER_BQ2589X
	tristate "TI BQ2589X Battery Charger"
	help
	  TI BQ2589X driver. enable support for OTG Wall Charger.

config FUELGAUGE_SM5602
	tristate "SM5602 fuel Gauge support"
	help
	  SM5602 fuel gauge driver. enable support for BMS.

endmenu
```
